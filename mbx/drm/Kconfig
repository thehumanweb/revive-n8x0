## mbx/drm/Kconfig
```kconfig
# SPDX-License-Identifier: GPL-2.0-only
config DRM_MBX
	tristate "PowerVR MBX (OMAP2420) render node"
	depends on DRM && ARCH_OMAP2 && MMU
	select DRM_GEM_SHMEM_HELPER
	help
	  DRM render-only driver for the PowerVR MBX of the OMAP2420 (Nokia
	  N800/N810): GEM buffers in the MBX's own address spaces, and jobs
	  made of a TA stream and a render. Display stays with omapdrm.
	  Userspace is the mbx Gallium driver of Mesa.

	  If M is selected the module is called mbx.
```

## rootfs/configs/n810_defconfig
```kconfig
# Nokia N810 (OMAP2420, ARM1136JF-S, ARMv6): a small glibc rootfs.
# The kernel is built separately (../kernel); its modules and mbxaccess.ko
# are overlaid by scripts/build-rootfs.sh.
BR2_arm=y
BR2_arm1136jf_s=y
BR2_ARM_EABI=y
BR2_ARM_FPU_VFPV2=y
BR2_TOOLCHAIN_BUILDROOT_GLIBC=y
BR2_KERNEL_HEADERS_6_18=y
BR2_TOOLCHAIN_BUILDROOT_CXX=y
BR2_TARGET_GENERIC_HOSTNAME="n810"
BR2_TARGET_GENERIC_ISSUE="Nokia N810"
BR2_TARGET_GENERIC_ROOT_PASSWD=""
BR2_TARGET_GENERIC_GETTY_PORT="ttyS2"
BR2_TARGET_GENERIC_GETTY_BAUDRATE_115200=y
BR2_ROOTFS_OVERLAY="$(BR2_EXTERNAL_N810_PATH)/board/n810/overlay $(BR2_EXTERNAL_N810_PATH)/build/modules-overlay"
BR2_PACKAGE_KMOD=y
BR2_PACKAGE_DROPBEAR=y
BR2_PACKAGE_MTD=y
BR2_TARGET_ROOTFS_TAR=y
BR2_TARGET_ROOTFS_EXT2=y
BR2_TARGET_ROOTFS_EXT2_4=y
BR2_TARGET_ROOTFS_EXT2_SIZE="96M"
BR2_TARGET_ROOTFS_JFFS2=y
BR2_TARGET_ROOTFS_JFFS2_CUSTOM=y
BR2_TARGET_ROOTFS_JFFS2_CUSTOM_EBSIZE=0x20000
BR2_TARGET_ROOTFS_JFFS2_NOCLEANMARKER=y
BR2_TARGET_ROOTFS_JFFS2_PAGESIZE=0x800
```

## rootfs/package/mbx-demo/Config.in
```kconfig
config BR2_PACKAGE_MBX_DEMO
	bool "mbx-demo"
	depends on BR2_PACKAGE_MESA3D_OPENGL_EGL
	depends on BR2_PACKAGE_MESA3D_OPENGL_ES
	depends on BR2_PACKAGE_MESA3D_GBM
	select BR2_PACKAGE_LIBDRM
	help
	  The mbx test programs that need Mesa: gbm_tri (an animated
	  triangle through EGL on GBM and KMS) and gles2_tri (the
	  offscreen triangle, written to a PPM). Sources are
	  mesa/tests in the n810 tree.
```
